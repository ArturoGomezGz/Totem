## firmware/bootstrap/sdkconfig.defaults.example
```kconfig
# Copiar a sdkconfig.defaults y ajustar los valores.
# Este archivo NO debe contener credenciales reales.
# sdkconfig.defaults está en .gitignore — nunca committear credenciales.

# Tabla de particiones personalizada con soporte OTA — debe coincidir con
# la de firmware/simulator (mismo layout de particiones ota_0/ota_1) para
# que un dispositivo flasheado con bootstrap pueda recibir por OTA
# cualquier versión publicada del firmware con funcionalidad real.
CONFIG_PARTITION_TABLE_CUSTOM=y
CONFIG_PARTITION_TABLE_CUSTOM_FILENAME="partitions.csv"

# Rollback automático: si un OTA no llega a confirmarse (ver
# bootstrap.c — pending_rollback_confirm / rollback_watchdog_task),
# el bootloader revierte solo a la partición anterior conocida como válida.
CONFIG_BOOTLOADER_APP_ROLLBACK_ENABLE=y
```

## firmware/monitorio/sdkconfig.defaults.example
```kconfig
# Copiar a sdkconfig.defaults y ajustar los valores.
# Este archivo NO debe contener credenciales reales.
# sdkconfig.defaults está en .gitignore — nunca committear credenciales.

# Tabla de particiones personalizada con soporte OTA — debe coincidir con
# la de firmware/bootstrap, firmware/simulator y firmware/genesis (mismo layout
# de particiones ota_0/ota_1) para que una unidad flasheada con bootstrap pueda
# recibir por OTA cualquier versión publicada de este firmware.
CONFIG_PARTITION_TABLE_CUSTOM=y
CONFIG_PARTITION_TABLE_CUSTOM_FILENAME="partitions.csv"

# partitions.csv ocupa 4MB exactos (nvs+otadata+ota_0+ota_1+spiffs) — el
# default de ESP-IDF es 2MB, insuficiente.
CONFIG_ESPTOOLPY_FLASHSIZE_4MB=y
CONFIG_ESPTOOLPY_FLASHSIZE="4MB"

# Rollback automático: si un OTA no llega a confirmarse (ver
# totem_core — totem_rollback.c), el bootloader revierte solo a la partición
# anterior conocida como válida.
CONFIG_BOOTLOADER_APP_ROLLBACK_ENABLE=y
```

## firmware/simulator/main/Kconfig.projbuild
```kconfig
menu "Simulator Configuration"

    config WIFI_SSID
        string "WiFi SSID"
        default "IoT"
        help
            SSID de la red WiFi a la que se conectará el simulador.

    config WIFI_PASSWORD
        string "WiFi Password"
        default ""
        help
            Contraseña de la red WiFi.

    config MQTT_BROKER_URI
        string "MQTT Broker URI"
        default "mqtt://192.168.1.100:1883"
        help
            URI completa del broker Mosquitto. Ejemplo: mqtt://10.0.0.1:1883

    config MQTT_USERNAME
        string "MQTT Username (unit_id)"
        default "sim-001"
        help
            Identificador único de la unidad. Debe coincidir con un registro en la DB.

    config MQTT_PASSWORD
        string "MQTT Password (api_key)"
        default ""
        help
            API key de la unidad generada por el dashboard. Solo para autenticación MQTT.

endmenu
```

## firmware/simulator/sdkconfig.defaults.example
```kconfig
# Copiar a sdkconfig.defaults y ajustar los valores.
# Este archivo NO debe contener credenciales reales.
# sdkconfig.defaults está en .gitignore — nunca committear credenciales.

# Tabla de particiones personalizada con soporte OTA
CONFIG_PARTITION_TABLE_CUSTOM=y
CONFIG_PARTITION_TABLE_CUSTOM_FILENAME="partitions.csv"
```
